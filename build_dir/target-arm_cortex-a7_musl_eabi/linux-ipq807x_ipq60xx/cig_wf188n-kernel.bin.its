## build_dir/target-arm_cortex-a7_musl_eabi/linux-ipq807x_ipq60xx/cig_wf188n-kernel.bin.its
```
/dts-v1/;

/ {
	description = "ARM OpenWrt FIT (Flattened Image Tree)";
	#address-cells = <1>;

	images {
		kernel-1 {
			description = "ARM OpenWrt Linux-4.4.60";
			data = /incbin/("/home/glinet/work/actions-runner/_work/gl-infra-builder/gl-infra-builder/wlan-ap/openwrt/build_dir/target-arm_cortex-a7_musl_eabi/linux-ipq807x_ipq60xx/cig_wf188n-kernel.bin");
			type = "kernel";
			arch = "arm";
			os = "linux";
			compression = "gzip";
			load = <0x41008000>;
			entry = <0x41008000>;
			hash@1 {
				algo = "crc32";
			};
			hash@2 {
				algo = "sha1";
			};
		};


		fdt-1 {
			description = "ARM OpenWrt cig_wf188n device tree blob";
			
			data = /incbin/("/home/glinet/work/actions-runner/_work/gl-infra-builder/gl-infra-builder/wlan-ap/openwrt/build_dir/target-arm_cortex-a7_musl_eabi/linux-ipq807x_ipq60xx/image-qcom-ipq6018-cig-wf188n.dtb");
			type = "flat_dt";
			
			arch = "arm";
			compression = "none";
			hash@1 {
				algo = "crc32";
			};
			hash@2 {
				algo = "sha1";
			};
		};



	};

	configurations {
		default = "config@cp03-c1";
		config@cp03-c1 {
			description = "OpenWrt cig_wf188n";
			kernel = "kernel-1";
			fdt = "fdt-1";
			
			
			
		};
		
	};
};
```

## build_dir/target-arm_cortex-a7_musl_eabi/linux-ipq807x_ipq60xx/edgecore_eap101-kernel.bin.its
```
/dts-v1/;

/ {
	description = "ARM OpenWrt FIT (Flattened Image Tree)";
	#address-cells = <1>;

	images {
		kernel-1 {
			description = "ARM OpenWrt Linux-4.4.60";
			data = /incbin/("/home/glinet/work/actions-runner/_work/gl-infra-builder/gl-infra-builder/wlan-ap/openwrt/build_dir/target-arm_cortex-a7_musl_eabi/linux-ipq807x_ipq60xx/edgecore_eap101-kernel.bin");
			type = "kernel";
			arch = "arm";
			os = "linux";
			compression = "gzip";
			load = <0x41008000>;
			entry = <0x41008000>;
			hash@1 {
				algo = "crc32";
			};
			hash@2 {
				algo = "sha1";
			};
		};


		fdt-1 {
			description = "ARM OpenWrt edgecore_eap101 device tree blob";
			
			data = /incbin/("/home/glinet/work/actions-runner/_work/gl-infra-builder/gl-infra-builder/wlan-ap/openwrt/build_dir/target-arm_cortex-a7_musl_eabi/linux-ipq807x_ipq60xx/image-qcom-ipq6018-edgecore-eap101.dtb");
			type = "flat_dt";
			
			arch = "arm";
			compression = "none";
			hash@1 {
				algo = "crc32";
			};
			hash@2 {
				algo = "sha1";
			};
		};



	};

	configurations {
		default = "config@cp01-c1";
		config@cp01-c1 {
			description = "OpenWrt edgecore_eap101";
			kernel = "kernel-1";
			fdt = "fdt-1";
			
			
			
		};
		
	};
};
```
